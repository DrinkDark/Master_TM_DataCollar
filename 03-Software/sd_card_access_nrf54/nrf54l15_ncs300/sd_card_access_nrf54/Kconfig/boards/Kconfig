## 03-Software/sd_card_access_nrf54/nrf54l15_ncs300/sd_card_access_nrf54/Kconfig/boards/Kconfig
```kconfig
# Load Zephyr board Kconfig descriptions.
osource "C:/ncs/v3.0.0/zephyr/boards/nordic/nrf54l15dk/Kconfig"
```
