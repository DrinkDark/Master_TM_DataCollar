&pinctrl {
    i2s20_default: i2s20_default {
        group1 {
            psels = <NRF_PSEL(I2S_SDOUT, 1, 14)>,   // MIC_DATA (TX)
                    <NRF_PSEL(I2S_LRCK_M, 1, 11)>,  // MIC_WS
                    <NRF_PSEL(I2S_SCK_M, 1, 12)>;   // MIC_CLK
        };
    };
};

i2s_tx: &i2s20 {
    status = "okay";
    pinctrl-0 = <&i2s20_default>;
    pinctrl-names = "default";
};

